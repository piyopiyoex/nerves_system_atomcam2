## nerves_defconfig
```kconfig
# Minimal AtomCam2 Nerves bring-up defconfig.
# This is intentionally scoped to first SSH and mDNS testing.

BR2_mipsel=y
BR2_TOOLCHAIN_EXTERNAL=y
BR2_TOOLCHAIN_EXTERNAL_CUSTOM=y
BR2_TOOLCHAIN_EXTERNAL_DOWNLOAD=y
BR2_TOOLCHAIN_EXTERNAL_URL="file://${NERVES_DEFCONFIG_DIR}/target/toolchains/atomcam2-mips32r2-nerves-toolchain.tar.xz"
BR2_TOOLCHAIN_EXTERNAL_CUSTOM_PREFIX="mipsel-nerves-linux-musl"
BR2_TOOLCHAIN_EXTERNAL_HEADERS_6_0=y
BR2_TOOLCHAIN_EXTERNAL_CUSTOM_MUSL=y
# BR2_TOOLCHAIN_EXTERNAL_INET_RPC is not set
BR2_TOOLCHAIN_EXTERNAL_CXX=y
BR2_TOOLCHAIN_EXTERNAL_FORTRAN=y
BR2_TOOLCHAIN_EXTERNAL_OPENMP=y
BR2_TAR_OPTIONS="--no-same-owner"
BR2_BACKUP_SITE="https://dl.nerves-project.org"
BR2_ENABLE_DEBUG=y
BR2_REPRODUCIBLE=y

BR2_GLOBAL_PATCH_DIR="${BR2_EXTERNAL_NERVES_PATH}/patches ${NERVES_DEFCONFIG_DIR}/patches"
BR2_TARGET_GENERIC_HOSTNAME="nerves"
BR2_TARGET_GENERIC_ISSUE="Nerves AtomCam2 experimental system"
BR2_ROOTFS_SKELETON_CUSTOM=y
BR2_ROOTFS_SKELETON_CUSTOM_PATH="${BR2_EXTERNAL_NERVES_PATH}/board/nerves-common/skeleton"
BR2_ROOTFS_DEVICE_TABLE="${BR2_EXTERNAL_NERVES_PATH}/board/nerves-common/device_table.txt"
BR2_ENABLE_LOCALE_WHITELIST="locale-archive"
BR2_GENERATE_LOCALE="en_US.UTF-8"
BR2_ROOTFS_OVERLAY="${BR2_EXTERNAL_NERVES_PATH}/board/nerves-common/rootfs_overlay ${NERVES_DEFCONFIG_DIR}/rootfs_overlay"
BR2_ROOTFS_POST_BUILD_SCRIPT="${BR2_EXTERNAL_NERVES_PATH}/board/nerves-common/post-build.sh ${NERVES_DEFCONFIG_DIR}/board/atomcam2/post-build.sh"

BR2_INIT_NONE=y
BR2_ROOTFS_DEVICE_CREATION_DYNAMIC_DEVTMPFS=y
BR2_TARGET_GENERIC_REMOUNT_ROOTFS_RW=n

BR2_LINUX_KERNEL=y
BR2_LINUX_KERNEL_CUSTOM_TARBALL=y
BR2_LINUX_KERNEL_CUSTOM_TARBALL_LOCATION="https://s3-us-west-2.amazonaws.com/download.wyzecam.com/firmware/gpl/Linux_kernel_3.10_Wyze_Cam_v3.tar.gz"
BR2_LINUX_KERNEL_PATCH="${NERVES_DEFCONFIG_DIR}/patches/kernel"
BR2_LINUX_KERNEL_USE_CUSTOM_CONFIG=y
BR2_LINUX_KERNEL_CUSTOM_CONFIG_FILE="${NERVES_DEFCONFIG_DIR}/linux-3.10.14.defconfig"
BR2_LINUX_KERNEL_LZMA=y
BR2_LINUX_KERNEL_IMAGE_TARGET_CUSTOM=y
BR2_LINUX_KERNEL_IMAGE_TARGET_NAME="uImage.lzma"

BR2_PACKAGE_BUSYBOX=y
BR2_PACKAGE_BUSYBOX_CONFIG="${BR2_EXTERNAL_NERVES_PATH}/board/nerves-common/busybox.config"
BR2_PACKAGE_BUSYBOX_CONFIG_FRAGMENT_FILES="${NERVES_DEFCONFIG_DIR}/busybox.fragment"
BR2_PACKAGE_CA_CERTIFICATES=y
BR2_PACKAGE_FWUP=y
BR2_PACKAGE_UNZIP=y
BR2_PACKAGE_LIBCURL=y
BR2_PACKAGE_LIBCURL_CURL=y
BR2_PACKAGE_LIBMNL=y
BR2_PACKAGE_ATOMCAM2_AICAP=y
BR2_PACKAGE_ATOMCAM2_BOOT_ANNOUNCE=y
BR2_PACKAGE_ATOMCAM2_CAMERA=y
BR2_PACKAGE_ATOMCAM2_COMPAT_HEADERS=y
BR2_PACKAGE_ATOMCAM2_VENDOR_COMPAT_SHIM=y
BR2_PACKAGE_ATOMCAM2_VIDEO_HOOK=y
BR2_PACKAGE_ATOMCAM2_V4L2LOOPBACK=y
BR2_PACKAGE_V4L2RTSPSERVER=y
BR2_PACKAGE_FINDUTILS=y
BR2_PACKAGE_E2FSPROGS=y
BR2_PACKAGE_UTIL_LINUX=y
BR2_PACKAGE_UTIL_LINUX_LIBBLKID=y
BR2_PACKAGE_UTIL_LINUX_LIBUUID=y
BR2_PACKAGE_UTIL_LINUX_SETPRIV=y
BR2_PACKAGE_KMOD=y
BR2_PACKAGE_KMOD_TOOLS=y
BR2_PACKAGE_WIRELESS_TOOLS=y
BR2_PACKAGE_WPA_SUPPLICANT=y
BR2_PACKAGE_WPA_SUPPLICANT_NL80211=y
BR2_PACKAGE_WPA_SUPPLICANT_CLI=y
BR2_PACKAGE_IW=y
BR2_PACKAGE_UBOOT_TOOLS=y
BR2_PACKAGE_HOST_UBOOT_TOOLS=y
BR2_PACKAGE_HOST_FWUP=y
BR2_PACKAGE_ERLANG=y
BR2_PACKAGE_ELIXIR=y
BR2_PACKAGE_NERVES_CONFIG=y
BR2_PACKAGE_NERVES_CONFIG_ACCEPT_RNG_NOTICE=y

BR2_TARGET_ROOTFS_SQUASHFS=y
BR2_TARGET_ROOTFS_SQUASHFS4_GZIP=y
BR2_NERVES_SYSTEM_NAME="nerves_system_atomcam2"
BR2_NERVES_ADDITIONAL_IMAGE_FILES="${NERVES_DEFCONFIG_DIR}/fwup.conf"
BR2_ROOTFS_POST_IMAGE_SCRIPT="${NERVES_DEFCONFIG_DIR}/scripts/post-image.sh"

BR2_PACKAGE_LIBNL=y

BR2_mips_xburst=y
```

## package/Config.in
```kconfig
source "$NERVES_DEFCONFIG_DIR/package/atomcam2-aicap/Config.in"
source "$NERVES_DEFCONFIG_DIR/package/atomcam2-boot-announce/Config.in"
source "$NERVES_DEFCONFIG_DIR/package/atomcam2-camera/Config.in"
source "$NERVES_DEFCONFIG_DIR/package/atomcam2-compat-headers/Config.in"
source "$NERVES_DEFCONFIG_DIR/package/atomcam2-vendor-compat-shim/Config.in"
source "$NERVES_DEFCONFIG_DIR/package/atomcam2-video-hook/Config.in"
source "$NERVES_DEFCONFIG_DIR/package/atomcam2-v4l2loopback/Config.in"
source "$NERVES_DEFCONFIG_DIR/package/v4l2cpp/Config.in"
source "$NERVES_DEFCONFIG_DIR/package/v4l2rtspserver/Config.in"
```

## package/atomcam2-aicap/Config.in
```kconfig
config BR2_PACKAGE_ATOMCAM2_AICAP
	bool "atomcam2-aicap"
	help
	  Install the prebuilt continuous microphone capture daemon
	  (atomcam2-aicap), which feeds raw PCM into a FIFO for
	  v4l2rtspserver's ALSA-free audio subsession to publish over
	  RTSP.
```
